## app/boards/arm/tipper_tf/Kconfig.board
```kconfig
# Tipper TF board configuration
# Copyright (c) 2021 weteor
# SPDX-License-Identifier: MIT

config BOARD_TIPPER_TF
        bool "tipper_tf"
        depends on SOC_NRF52840_QIAA
```

## app/boards/arm/tipper_tf/Kconfig.defconfig
```kconfig
# Copyright (c) 2021 weteor
# SPDX-License-Identifier: MIT

if BOARD_TIPPER_TF

config BOARD
        default "Tipper TF"

config ZMK_KEYBOARD_NAME
        default "Tipper TF"

if USB

config USB_NRFX
        default y

config USB_DEVICE_STACK
        default y

endif # USB

config BT_CTLR
        default BT

config ZMK_BLE
        default y

config ZMK_USB
        default y

config ZMK_BATTERY_VOLTAGE_DIVIDER
        default y

endif # BOARD_TIPPER_TF
```

## app/boards/arm/tipper_tf/tipper_tf_defconfig
```kconfig
# Copyright (c) 2021 weteor
# SPDX-License-Identifier: MIT

CONFIG_SOC_SERIES_NRF52X=y
CONFIG_SOC_NRF52840_QIAA=y
CONFIG_BOARD_TIPPER_TF=y

#enable MPU
CONFIG_ARM_MPU=y

#enable GPIO
CONFIG_GPIO=y

CONFIG_ZMK_SLEEP=y

CONFIG_ZMK_DISPLAY=y
CONFIG_LVGL_USE_THEME_MONO=y
CONFIG_LVGL_THEME_DEFAULT_COLOR_PRIMARY_RED=n
CONFIG_LVGL_THEME_DEFAULT_COLOR_SECONDARY_RED=n
CONFIG_LVGL_THEME_DEFAULT_COLOR_PRIMARY_BLACK=y
CONFIG_LVGL_THEME_DEFAULT_COLOR_SECONDARY_WHITE=y

CONFIG_USE_DT_CODE_PARTITION=y

CONFIG_MPU_ALLOW_FLASH_WRITE=y
CONFIG_NVS=y
CONFIG_SETTINGS_NVS=y
CONFIG_FLASH=y
CONFIG_FLASH_PAGE_LAYOUT=y
CONFIG_FLASH_MAP=y
```

## app/dts/bindings/display/gooddisplay,jd79653.yaml
```yaml
# Copyright (c) 2020, Phytec Messtechnik GmbH
# SPDX-License-Identifier: Apache-2.0

description: JD79653 EPD display controller

compatible: "gooddisplay,jd79653"

include: spi-device.yaml

properties:
    height:
      type: int
      required: true
      description: Height in pixel of the panel driven by the controller

    width:
      type: int
      required: true
      description: Width in pixel of the panel driven by the controller

    reset-gpios:
      type: phandle-array
      required: true
      description: RESET pin.

        The RESET pin of JD79653 is active low.
        If connected directly the MCU pin should be configured
        as active low.

    dc-gpios:
      type: phandle-array
      required: true
      description: DC pin.

        The DC pin of JD79653 is active low (transmission command byte).
        If connected directly the MCU pin should be configured
        as active low.

    busy-gpios:
      type: phandle-array
      required: true
      description: BUSY pin.

        The BUSY pin of JD79653 is active low.
        If connected directly the MCU pin should be configured
        as active low.

    pwr:
      type: uint8-array
      required: true
      description: Power Setting (PWR) values

    cdi:
      type: int
      required: true
      description: VCOM and data interval value

    tcon:
      type: int
      required: true
      description: TCON setting value

    vcom-dc:
      type: int
      required: true
      description: VCOM DC setting value
```
